/*
 * Copyright (c) 2020 The ZMK Contributors
 *
 * SPDX-License-Identifier: MIT
 */


#define LILY58_STANDARD_LABELS

#include "zmk-helpers/key-labels/lily58.h"

/* Layers */
#define DEF 0
#define NAV 1
#define MOUSE 2

#include "base.dtsi"

// combo: RC(0,0) + RC(0,1) -> Studio Unlock
ZMK_COMBO(unlock_studio, &studio_unlock, LN5 LN4, ALL, COMBO_TERM_FAST, COMBO_IDLE_FAST)

// tap: media next | double-tap: media previous
ZMK_TAP_DANCE(l_rot,
    tapping-term-ms = <250>;
    bindings = <&kp C_NEXT>, <&kp C_PREV>;
)

// tap: play/pause | double-tap: mute
ZMK_TAP_DANCE(r_rot,
    tapping-term-ms = <250>;
    bindings = <&kp C_PP>, <&kp C_MUTE>;
)

&sensors {
    triggers-per-rotation = <40>;
};

/* Keymap */

ZMK_LAYER(base,
//╭─────────────┬─────────────┬─────────────┬─────────────┬─────────────┬─────────────╮                   ╭─────────────┬─────────────┬─────────────┬─────────────┬─────────────┬─────────────╮
    &kp N1        &kp N2        &kp N3        &kp N4        &kp N5        &kp N6                            &kp N7        &kp N8        &kp N9        &kp N0        &kp MINUS       &kp EQUAL
//├─────────────┼─────────────┼─────────────┼─────────────┼─────────────┼─────────────┤                   ├─────────────┼─────────────┼─────────────┼─────────────┼─────────────┼─────────────┤
    &kp TAB       &kp Q         &kp W         &kp E         &kp R         &kp T                             &kp Y         &kp U         &kp I         &kp O         &kp P           &kp LBKT
//├─────────────┼─────────────┼─────────────┼─────────────┼─────────────┼─────────────┤                   ├─────────────┼─────────────┼─────────────┼─────────────┼─────────────┼─────────────┤
    &kp GRAVE     &hml LGUI A   &hml LALT S   &hml LSHFT D  &hml LCTRL F  &kp G                             &kp H         &hmr LCTRL J  &hmr RSHFT K  &hmr LALT L   &hmr LGUI SEMI  &kp APOS
//├─────────────┼─────────────┼─────────────┼─────────────┼─────────────┼─────────────┤ ╭──────╮ ╭──────╮ ├─────────────┼─────────────┼─────────────┼─────────────┼─────────────┼─────────────┤
    &kp BSLH      &kp Z         &kp X         &kp C         &kp V         &kp B          &l_rot   &r_rot    &kp N         &kp M         &kp COMMA     &kp DOT       &kp FSLH        &kp RBKT
//╰─────────────┴─────────────┼─────────────┼─────────────┼─────────────┼─────────────┤ ╰──────╯ ╰──────╯ ├─────────────┼─────────────┼─────────────┼─────────────┼─────────────┴─────────────╯
                                &copy_cut     &kp PSCRN     &kp ESC       &lt NAV RET                       &lt_spc NAV 0 NAV_BSPC      NAV_DEL       PASTE
//                            ╰─────────────┴─────────────┴─────────────┴─────────────╯                   ╰─────────────┴─────────────┴─────────────┴─────────────╯
  , &inc_dec_kp PG_UP PG_DN &inc_dec_kp C_VOL_UP C_VOL_DN
)

ZMK_LAYER(nav,
//╭─────────────┬─────────────┬─────────────┬─────────────┬─────────────┬─────────────╮                   ╭─────────────┬─────────────┬─────────────┬─────────────┬─────────────┬─────────────╮
    &kp F1        &kp F2        &kp F3        &kp F4         &kp F5         &kp F6                          &kp C_PREV    &kp C_PP      &kp C_NEXT    &kp C_MUTE    &kp C_VOL_UP  &kp C_VOL_DN
//├─────────────┼─────────────┼─────────────┼─────────────┼─────────────┼─────────────┤                   ├─────────────┼─────────────┼─────────────┼─────────────┼─────────────┼─────────────┤
    &kp F7        &hml LGUI F8  &hml LALT F9  &hml LSHFT F10 &hml LCTRL F11 &kp F12                         &kp HOME      &kp PG_DN     &kp PG_UP     &kp END       &kp C_BRI_UP  &kp C_BRI_UP
//├─────────────┼─────────────┼─────────────┼─────────────┼─────────────┼─────────────┤                   ├─────────────┼─────────────┼─────────────┼─────────────┼─────────────┼─────────────┤
    ___           ___           ___           ___           ___           &mo MOUSE                         NAV_LEFT      NAV_DOWN      NAV_UP        NAV_RIGHT     &leader       &leader_sft
//├─────────────┼─────────────┼─────────────┼─────────────┼─────────────┼─────────────┤ ╭──────╮ ╭──────╮ ├─────────────┼─────────────┼─────────────┼─────────────┼─────────────┼─────────────┤
    ___           ___           ___           ___           ___           ___             ___      ___      &kp INS       &kp TAB       &kp LT        &kp GT        ___           ___
//╰─────────────┴─────────────┼─────────────┼─────────────┼─────────────┼─────────────┤ ╰──────╯ ╰──────╯ ├─────────────┼─────────────┼─────────────┼─────────────┼─────────────┴─────────────╯
                                ___           ___           ___           XXX                               XXX           CANCEL        ___           ___
//                            ╰─────────────┴─────────────┴─────────────┴─────────────╯                   ╰─────────────┴─────────────┴─────────────┴─────────────╯
)

ZMK_LAYER(mouse,
//╭─────────────┬─────────────┬─────────────┬─────────────┬─────────────┬─────────────╮                   ╭─────────────┬─────────────┬─────────────┬─────────────┬─────────────┬─────────────╮
    ___           ___           ___           ___           ___           ___                               ___           ___           ___           ___           ___           ___
//├─────────────┼─────────────┼─────────────┼─────────────┼─────────────┼─────────────┤                   ├─────────────┼─────────────┼─────────────┼─────────────┼─────────────┼─────────────┤
    ___           ___           ___           ___           ___           ___                               ___           &mkp LCLK     &mkp MCLK     &mkp RCLK     ___           ___
//├─────────────┼─────────────┼─────────────┼─────────────┼─────────────┼─────────────┤                   ├─────────────┼─────────────┼─────────────┼─────────────┼─────────────┼─────────────┤
    ___           ___           ___           ___           ___           XXX                               U_MS_L        U_MS_D        U_MS_U        U_MS_R        ___           ___
//├─────────────┼─────────────┼─────────────┼─────────────┼─────────────┼─────────────┤ ╭──────╮ ╭──────╮ ├─────────────┼─────────────┼─────────────┼─────────────┼─────────────┼─────────────┤
    ___           ___           ___           ___           ___           ___             ___      ___      ___           ___           ___           ___           ___           ___
//╰─────────────┴─────────────┼─────────────┼─────────────┼─────────────┼─────────────┤ ╰──────╯ ╰──────╯ ├─────────────┼─────────────┼─────────────┼─────────────┼─────────────┴─────────────╯
                                ___           ___           ___           XXX                               ___           CANCEL        ___           ___
//                            ╰─────────────┴─────────────┴─────────────┴─────────────╯                   ╰─────────────┴─────────────┴─────────────┴─────────────╯
)
