## config/west.yml
```yaml
manifest:
  defaults:
    revision: main # Pin everything to v0.3

  remotes:
    - name: zmkfirmware
      url-base: https://github.com/zmkfirmware
    # Additional modules containing boards/shields/custom code can be listed here as well
    # See https://docs.zephyrproject.org/3.2.0/develop/west/manifest.html#projects
    - name: urob
      url-base: https://github.com/urob
    - name: petejohanson
      url-base: https://github.com/petejohanson
    - name: caksoylar
      url-base: https://github.com/caksoylar
    - name: keeb-it
      url-base: https://github.com/keeb-it

  projects:
    - name: zmk
      remote: zmkfirmware
      import: app/west.yml
    - name: zmk-keyboards
      remote: keeb-it
    - name: zmk-rgbled-widget
      remote: caksoylar
    - name: zmk-adaptive-key
      path: modules/zmk/adaptive-key
      remote: urob
    - name: zmk-auto-layer
      path: modules/zmk/auto-layer
      remote: urob
      revision: next
    - name: zmk-helpers
      path: modules/zmk/helpers
      remote: urob
    - name: zmk-leader-key
      path: modules/zmk/leader-key
      remote: urob
    - name: zmk-tri-state
      path: modules/zmk/tri-state
      remote: urob
    - name: zmk-unicode
      path: modules/zmk/unicode
      remote: urob
    # - name: cirque-input-module
    #   remote: petejohanson
    #   revision: main
  self:
    path: config
```
